//#include "vexpress-v2p-ca9.dts"
/ {
#if 0
	pinctrl_i2c: i2cgrp {
			fsl,pins = <
				MX6UL_PAD_UART4_TX_DATA__I2C1_SCL 0x4001b8b0
				MX6UL_PAD_UART4_RX_DATA__I2C1_SDA 0x4001b8b0
			>;
		};

	v2m_i2c_0: i2c@2000  {
		label = "v2m:i2c:user1";
		compatible = "arm,i2c-test";
		reg = <0x2000>;
		gpios = <&v2m_i2c_pcie 0 0>;
		status = "okay";
		eeprom@50 {
			compatible = "arm,i2c-test";
        	reg = <0x50>;
		};
	};
#endif

	eeprom@2000 {
		compatible = "arm,i2c-test";
		reg = <0x50>;
		//pagesize = <16>;
		};
	
#if 0
	&i2c0 {
		status = "okay";
	};
#endif

};
